## build/conf/bblayers.conf
```bitbake
# POKY_BBLAYERS_CONF_VERSION is increased each time build/conf/bblayers.conf
# changes incompatibly
POKY_BBLAYERS_CONF_VERSION = "2"

BBPATH = "${TOPDIR}"
BBFILES ?= ""

BBLAYERS ?= " \
  /home/project2/project2/yocto/poky/meta \
  /home/project2/project2/yocto/poky/meta-poky \
  /home/project2/project2/yocto/poky/meta-raspberrypi \
  /home/project2/project2/yocto/poky/meta-openembedded/meta-oe \
  /home/project2/project2/yocto/poky/meta-openembedded/meta-perl \
  /home/project2/project2/yocto/poky/meta-openembedded/meta-python \
  /home/project2/project2/yocto/poky/meta-openembedded/meta-networking \
  /home/project2/project2/yocto/poky/meta-openembedded/meta-filesystems \
  /home/project2/project2/yocto/poky/meta-openembedded/meta-webserver \
  /home/project2/project2/yocto/poky/meta-openembedded/meta-multimedia \
  /home/project2/project2/yocto/rpi4/meta-cctv \
  "
```
